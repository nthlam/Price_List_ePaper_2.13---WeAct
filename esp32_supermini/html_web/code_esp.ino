// them thu vien epaper
  #include <GxEPD2_3C.h>
  #include <Fonts/FreeMonoBold9pt7b.h>

  #define LED_BUILTIN 8
    #define SCL 4  //SCK
    #define SDA 6  //MOSI
    #define SS 7
    #define BUSY 3
    #define RST 2
    #define DC 1
  
  GxEPD2_3C<GxEPD2_213_Z98c, GxEPD2_213_Z98c::HEIGHT> display(GxEPD2_213_Z98c(/*CS=5*/ SS, /*DC=*/ 1, /*RST=*/ 2, /*BUSY=*/ 3)); // GDEY0213Z98 122x250, SSD1680

/////// XỬ LÍ WIFI
#include <WiFi.h>
#include <WebServer.h>
const char* ssid = "ESP32-Access-Point";
const char* password = "12345678";

WebServer server(80);

String name = "";
String price = "";

const char* formHTML = R"rawliteral(
<!DOCTYPE html>
<html>
<head><meta charset="UTF-8"><title>Nhập dữ liệu</title></head>
<body>
  <h2>Nhập tên và giá:</h2>
  <form action="/submit" method="GET">
    Tên: <input type="text" name="name"><br>
    Giá: <input type="text" name="price"><br>
    <input type="submit" value="Gửi">
  </form>
  <p>Tên: %NAME%</p>
  <p>Giá: %PRICE%</p>
</body>
</html>
)rawliteral";

String processHTML(String html) {
  html.replace("%NAME%", name);
  html.replace("%PRICE%", price);
  return html;
}

static const uint8_t image_data_vinmart1[3050]  = {
    0xb6, 0xdb, 0x6d, 0xb6, 0xdb, 0x6d, 0xb6, 0xdb, 0x6d, 0xb6, 0xdb, 0x6d, 0xb6, 0xdb, 0x6d, 0xb6, 0xdb, 0x6d, 0xb6, 0xdb, 0x6d, 0xb6, 0xdb, 0x6d, 0xb6, 
    0xdb, 0x6d, 0xb6, 0xdb, 0x6d, 0xb6, 0xdb, 0x6d, 0xb6, 0xdb, 0x6d, 0xb6, 0xdb, 0x6d, 0xb6, 0xdb, 0x6d, 0xb6, 0xdb, 0x6d, 0xb6, 0xdb, 0x6d, 0xb6, 0xdb, 
    0x6d, 0xb6, 0xdb, 0x6d, 0xb6, 0xdb, 0x6d, 0xb6, 0xdb, 0x6d, 0xb6, 0xdb, 0x6d, 0xb6, 0xdb, 0x6d, 0xb6, 0xdb, 0x6d, 0xb6, 0xdb, 0x6d, 0xb6, 0xdb, 0x6d, 
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    0x5b, 0xdb, 0x56, 0xaa, 0x9b, 0x5d, 0xdb, 0x5a, 0xb6, 0xb6, 0xed, 0xb6, 0xba, 0xae, 0xdb, 0x6d, 0xaf, 0x54, 0xd5, 0xad, 0x6a, 0xb6, 0xb6, 0xba, 0xdd
};

static const uint8_t image_data_vinmart[3904] = {
    0xb6, 0xdb, 0x6d, 0xb6, 0xdb, 0x6d, 0xb6, 0xdb, 0x6d, 0xb6, 0xdb, 0x6d, 0xb6, 0xdb, 0x6d, 0xb6, 0xdb, 0x6d, 0xb6, 0xdb, 0x6d, 0xb6, 0xdb, 0x6d, 0xb6, 0xdb, 0x6d, 0xb6, 0xdb, 0x6d, 0xb6, 0xc0, 
    0xdb, 0x6d, 0xb6, 0xdb, 0x6d, 0xb6, 0xdb, 0x6d, 0xb6, 0xdb, 0x6d, 0xb6, 0xdb, 0x6d, 0xb6, 0xdb, 0x6d, 0xb6, 0xdb, 0x6d, 0xb6, 0xdb, 0x6d, 0xb6, 0xdb, 0x6d, 0xb6, 0xdb, 0x6d, 0xb6, 0xdb, 0x40, 
    0x6d, 0xb6, 0xdb, 0x6d, 0xb6, 0xdb, 0x6d, 0xb6, 0xdb, 0x6d, 0xb6, 0xdb, 0x6d, 0xb6, 0xdb, 0x6d, 0xb6, 0xdb, 0x6d, 0xb6, 0xdb, 0x6d, 0xb6, 0xdb, 0x6d, 0xb6, 0xdb, 0x6d, 0xb6, 0xdb, 0x6d, 0x40, 
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    0x6a, 0xdb, 0x56, 0x9b, 0x5a, 0xb5, 0x6d, 0x77, 0x6d, 0xd5, 0x5a, 0xb5, 0x57, 0x76, 0xd5, 0x6a, 0xde, 0xdd, 0x5b, 0xd5, 0x5a, 0xdd, 0xb6, 0xf5, 0xda, 0xb5, 0xb6, 0xb7, 0x5b, 0x6e, 0xda, 0xc0
};

void handleRoot() {
  server.send(200, "text/html", processHTML(formHTML));
}

void handleSubmit() {
  if (server.hasArg("name")) name = server.arg("name");
  if (server.hasArg("price")) price = server.arg("price");
  server.send(200, "text/html", processHTML(formHTML));
  // GỬI DỮ LIỆU QUA SERIAL
  Serial.println(name); capnhat(  name, 40, 50, 150,20);
  Serial.println(price); capnhat(  price, 40, 90, 150,20);
}

void setup() {
  // khoi tao serial + led
  pinMode(8, OUTPUT);
  digitalWrite(8, HIGH);
  Serial.begin(115200);

  // tạo ĐIỂM KẾT NỐI WF
  WiFi.softAP(ssid, password);
  Serial.println("Access Point IP: " + WiFi.softAPIP().toString());
  String ip_add = WiFi.softAPIP().toString();
  server.on("/", handleRoot);          // gán endpoint với hàm 
  server.on("/submit", handleSubmit);
  server.begin();

  digitalWrite(8, LOW);
  // KHỞI TẠO MÀN HÌNH
  display.init(115200, true, 50, false);
  Serial.println("Da init Word...");
  //--//
  display.setRotation(1);
  display.setFullWindow();
  display.firstPage();
do {
  display.setFont(&FreeMonoBold9pt7b);
  display.setTextColor(GxEPD_BLACK);
  display.setCursor(100, 65);
  display.println("IP:");
  display.println(ip_add);
} while (display.nextPage());
 
  delay(5000);
  // IN TEMPLATE 
  display.firstPage();
  do {
    display.fillScreen(GxEPD_WHITE);
    // display.drawBitmap(10, 10, image_data_logo, 150, 50, GxEPD_BLACK);
    display.drawBitmap(0, 0, image_data_vinmart, 250, 122, GxEPD_RED);
    // display.drawBitmap(0, 0, VN_flag_bitmap , 250, 122, GxEPD_RED);
  } while (display.nextPage());
  /////
  digitalWrite(8, HIGH);

}

void loop() {
  server.handleClient();
}

void capnhat(String text, int x, int y, int ngang, int doc){
  display.setPartialWindow(x, y, ngang, doc);
  display.firstPage();
  do {
    display.setFont(&FreeMonoBold9pt7b);
    display.setTextColor(GxEPD_BLACK);
    display.setCursor(x, y +  doc/2 + 5 );
    display.print(text);
  } while (display.nextPage());
}
